## boards/shields/Kconfig.defconfig
```kconfig
if SHIELD_THINK_CORNEY_V1B1_RIGHT

config ZMK_KEYBOARD_NAME
    default "ThinkCorneyV1B1"

config ZMK_SPLIT_ROLE_CENTRAL
    default y

endif

if SHIELD_MY_BOARD_RIGHT || SHIELD_MY_BOARD_LEFT

config ZMK_SPLIT
    default y

endif
```

## boards/shields/Kconfig.shield
```kconfig
config SHIELD_THINK_CORNEY_V1B1_LEFT
    def_bool $(shields_list_contains,think_corney_v1b1_left)

config SHIELD_THINK_CORNEY_V1B1_RIGHT
    def_bool $(shields_list_contains,think_corney_v1b1_right)
```
