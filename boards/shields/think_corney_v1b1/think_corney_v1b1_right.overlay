#include "think_corney_v1b1.dtsi"

&default_transform {
    col-offset = <6>;
};

&kscan0 {
    col-gpios
        = <&pro_micro 14 GPIO_ACTIVE_HIGH>
        , <&pro_micro 15 GPIO_ACTIVE_HIGH>
        , <&pro_micro 18 GPIO_ACTIVE_HIGH>
        , <&pro_micro 19 GPIO_ACTIVE_HIGH>
        , <&pro_micro 20 GPIO_ACTIVE_HIGH>
        , <&pro_micro 21 GPIO_ACTIVE_HIGH>
        ;
};

/*
 * PS/2 Mouse / Trackpoint
 */

// Enable PS/2 drivers on this side of the keyboard.
// MUST be the central.
//
// Comment out the following define to use the GPIO driver instead of UART
// (this is not recommended unless you can't use the UART driver for whatever
// reason)
#define MOUSE_PS2_DRIVER_UART

#ifdef MOUSE_PS2_DRIVER_UART
    &uart0 {
        status = "okay";
    };
    &uart_ps2 {
        status = "okay";
    };
#else
    &gpio_ps2 {
        status = "okay";
    };
#endif
