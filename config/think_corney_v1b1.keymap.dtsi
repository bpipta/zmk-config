/* Enable keymap features that require forks */
// #define HAS_UROB
#define HAS_MOUSE_KEYS
#define HAS_MOUSE_TP

/* source the main keymap */
#include "../boards/shields/think_corney_v1b1/think_corney_v1b1.keymap"
